{\rtf1\ansi\ansicpg1252\cocoartf2636
\cocoatextscaling0\cocoaplatform0{\fonttbl\f0\fswiss\fcharset0 Helvetica;}
{\colortbl;\red255\green255\blue255;}
{\*\expandedcolortbl;;}
\margl1440\margr1440\vieww11520\viewh8400\viewkind0
\pard\tx720\tx1440\tx2160\tx2880\tx3600\tx4320\tx5040\tx5760\tx6480\tx7200\tx7920\tx8640\pardirnatural\partightenfactor0

\f0\fs24 \cf0 ; *************************************************************\
; *** Scatter-Loading Description File generated by uVision ***\
; *************************************************************\
\
LR_IROM1 0x00000000 0x00008000  \{    ; load region size_region\
  ER_IROM1 0x00000000 0x00008000  \{  ; load address = execution address\
   *.o (RESET, +First)\
   *(InRoot$$Sections)\
   .ANY (+RO)\
   .ANY (+XO)\
  \}\
  RW_IRAM1 0x20000000 0x00008000  \{  ; RW data\
   .ANY (+RW +ZI)\
  \}\
\}\
}